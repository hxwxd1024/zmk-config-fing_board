## config/boards/shields/hshs52/Kconfig.defconfig
```kconfig
# Copyright (c) 2021-2022 The ZMK Contributors
# SPDX-License-Identifier: MIT

if SHIELD_HSHS52_LEFT

config ZMK_KEYBOARD_NAME
    default "HSHS52"

config ZMK_SPLIT_BLE_ROLE_CENTRAL
    default y

endif

if SHIELD_HSHS52_LEFT || SHIELD_HSHS52_RIGHT

config ZMK_SPLIT
    default y

endif

config SHIELD_HSHS52_DONGLE
    def_bool $(shields_list_contains,hshs52_dongle)
```

## config/boards/shields/hshs52/Kconfig.shield
```kconfig
# Copyright (c) 2021-2022 The ZMK Contributors
# SPDX-License-Identifier: MIT

config SHIELD_fing_board_LEFT
    def_bool $(shields_list_contains,fing_board_left)

config SHIELD_fing_board_RIGHT
    def_bool $(shields_list_contains,fing_board_right)

config SHIELD_fing_board_DONGLE
    def_bool $(shields_list_contains,fing_board_dongle)
```
